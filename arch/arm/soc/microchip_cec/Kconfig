## arch/arm/soc/microchip_cec/Kconfig
```kconfig
config SOC_FAMILY_CEC
	bool
	# omit prompt to signify a "hidden" option
	default n

if SOC_FAMILY_CEC
config SOC_FAMILY
	string
	default "microchip_cec"
endif

choice
	prompt "Microchip CECxxxx MCU Selection"
	depends on SOC_FAMILY_CEC

config SOC_CEC1702
	bool "CEC1702"

endchoice
```

## arch/arm/soc/microchip_cec/Kconfig.defconfig
```kconfig
if SOC_FAMILY_CEC

config SOC
	default microchip_cec

config NUM_IRQS
	int
	# must be >= the highest interrupt number used
	# - include the UART interrupts
	default 34

config SYS_CLOCK_HW_CYCLES_PER_SEC
	int
	default 48000000

endif
```

## arch/arm/soc/microchip_cec/Kconfig.soc
```kconfig
config SOC_FAMILY_CEC
	bool "Microchip CECxxxx MCU"
	select CPU_CORTEX_M
	select CPU_CORTEX_M4
	select CPU_HAS_SYSTICK
	select HAS_CEC_HAL
	help
	  Enable support for Micochip CEC Cortex-M4 microcontrollers.
```

## boards/arm/secureiot1702/Kconfig.board
```kconfig
config BOARD_SECUREIOT1702
	bool "Microchip SecureIoT1702"
	depends on SOC_FAMILY_CEC
	select HAS_DTS
	select SOC_PART_NUMBER_CEC1702
```

## boards/arm/secureiot1702/Kconfig.defconfig
```kconfig
#
# Copyright (c) 2019 Crypta Labs Ltd.
#
# SPDX-License-Identifier: Apache-2.0
#

if BOARD_SECUREIOT1702

config BOARD
	default "secureiot1702"

if UART_NS16550

config UART_NS16550_PORT_0
	def_bool y

config UART_NS16550_PORT_1
	def_bool y

endif

endif
```

## boards/arm/secureiot1702/secureiot1702_defconfig
```kconfig
CONFIG_ARM=y
CONFIG_SOC_SERIES_CEC=y
CONFIG_SOC_CEC1702=y
CONFIG_BOARD_SECUREIOT1702=y
CONFIG_CORTEX_M_SYSTICK=y
CONFIG_SYS_CLOCK_HW_CYCLES_PER_SEC=48000000

CONFIG_SERIAL=y
CONFIG_CONSOLE=y
CONFIG_UART_CONSOLE=y

CONFIG_SPI=y
CONFIG_SPI_CEC_QMSPI=y
CONFIG_SPI_0=y
CONFIG_SPI_0_IRQ_PRI=0
CONFIG_SPI_0_NAME="QMSPI0"

CONFIG_FLASH=y
CONFIG_SPI_FLASH_SFDP=y
CONFIG_SPI_FLASH_SFDP_SPI_NAME="QMSPI0"
CONFIG_SPI_FLASH_SFDP_SPI_FREQ_0=12000000

# No DT support for these yet
CONFIG_UART_NS16550=y
CONFIG_UART_NS16550_PORT_0=y
CONFIG_UART_NS16550_PORT_1=y
```

## drivers/spi/Kconfig.cec_qmspi
```kconfig
#
# Copyright (c) 2019 Crypta Labs Ltd.
#
# SPDX-License-Identifier: Apache-2.0
#

config SPI_CEC_QMSPI
	bool
	prompt "CEC MCU QMSPI controller driver"
	depends on SPI && SOC_SERIES_CEC
	default n
	help
	  Enable Quad Master SPI support on the CEC series of processors.

if SPI_CEC_QMSPI

config SPI_CEC_QMSPI_INTERRUPT
	bool "CEC QMSPI Interrupt Support"
	help
	  Enable Interrupt support for the SPI Driver of CEC QMSPI.
	  NOTE: Work in progress. Not ready yet.

endif # SPI_CEC_QMSPI
```

## dts/bindings/spi/microchip,cec-gpspi.yaml
```yaml
#
# Copyright (c) 2019 Crypta Labs Ltd.
#
# SPDX-License-Identifier: Apache-2.0
#
---
title: Microchip CEC GPSPI

description: |
    This binding gives a base representation of the Microchip CEC GPSPI controller

compatible: "microchip,cec-gpspi"

include: spi-controller.yaml

properties:
    reg:
      required: true
      type: array
      description: mmio register space

...
```

## dts/bindings/spi/microchip,cec-qmspi.yaml
```yaml
#
# Copyright (c) 2019 Crypta Labs Ltd.
#
# SPDX-License-Identifier: Apache-2.0
#
---
title: Microchip CEC QMSPI

description: |
    This binding gives a base representation of the Microchip CEC QMSPI controller

compatible: "microchip,cec-qmspi"

include: spi-controller.yaml

properties:
    reg:
      required: true
      type: array
      description: mmio register space

...
```

## ext/hal/microchip/Kconfig
```kconfig
# Kconfig - Microchip CEC/MEC HAL drivers configuration
#
# SPDX-License-Identifier: Apache-2.0

menuconfig HAS_MEC_HAL
	bool "Microchip MEC HAL drivers support"

menuconfig HAS_CEC_HAL
	bool "Microchip CEC HAL drivers support"
```

## soc/arm/microchip_cec/Kconfig
```kconfig
# Kconfig - Microchip CEC MCU line
#
# Copyright (c) 2019 Crypta Labs Ltd.
#
# SPDX-License-Identifier: Apache-2.0

choice
	prompt "Microchip CECxxxx MCU Selection"
	depends on SOC_SERIES_CEC

config SOC_CEC1702
	bool "CEC1702"

endchoice
```

## soc/arm/microchip_cec/Kconfig.defconfig
```kconfig
# Kconfig - Microchip CEC MCU line
#
# Copyright (c) 2019 Crypta Labs Ltd.
#
# SPDX-License-Identifier: Apache-2.0

if SOC_SERIES_CEC

config SOC
	string
	default "microchip_cec"

config NUM_IRQS
	int
	# must be >= the highest interrupt number used
	# - include the UART interrupts
	default 42

config SYS_CLOCK_HW_CYCLES_PER_SEC
	int
	default 48000000

if SERIAL

config UART_NS16550
	def_bool y

endif # SERIAL

if SPI

config SPI_CEC_QMSPI
	default y

endif # SPI

endif
```

## soc/arm/microchip_cec/Kconfig.soc
```kconfig
# Kconfig - Microchip CEC MCU line
#
# Copyright (c) 2019 Crypta Labs Ltd.
#
# SPDX-License-Identifier: Apache-2.0

config SOC_SERIES_CEC
	bool "Microchip CECxxxx MCU"
	select CPU_CORTEX_M
	select CPU_CORTEX_M4
	select CPU_CORTEX_M_HAS_SYSTICK
	select CPU_HAS_FPU
	select HAS_CEC_HAL
	help
	  Enable support for Micochip CEC Cortex-M4 microcontrollers.
```

## soc/arm/microchip_mec/cec1702/Kconfig.defconfig.cec1702
```kconfig
# Microchip CEC1702

# Copyright (c) 2019 Crypta Labs Ltd.
# SPDX-License-Identifier: Apache-2.0

if SOC_CEC1702

config SOC
	default "cec1702"

config SYS_CLOCK_HW_CYCLES_PER_SEC
	default 48000000

if SERIAL

config UART_NS16550
	default y

endif # SERIAL

if SPI

config SPI_XEC_QMSPI
	def_bool n

config SPI_CEC_QMSPI
	def_bool y

config SPI_CEC_GPSPI
       def_bool y

endif # SPI

endif # SOC_CEC1702
```
